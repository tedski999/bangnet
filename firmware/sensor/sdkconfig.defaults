## firmware/sensor/sdkconfig.defaults
```kconfig
CONFIG_SECURE_SIGNED_APPS_NO_SECURE_BOOT=y
CONFIG_SECURE_SIGNED_ON_BOOT_NO_SECURE_BOOT=y
CONFIG_ESPTOOLPY_FLASHSIZE_4MB=y
CONFIG_PARTITION_TABLE_TWO_OTA=y
CONFIG_PARTITION_TABLE_OFFSET=0x9000
CONFIG_COMPILER_OPTIMIZATION_SIZE=y
CONFIG_XTAL_FREQ_AUTO=y
CONFIG_FREERTOS_HZ=1000
CONFIG_LOG_MAXIMUM_LEVEL_DEBUG=y
```
